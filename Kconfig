## config/board/shields/lizball/kconfig.defconfig
```kconfig
# Copyright (c) 2025 ZMK Contributors
# SPDX-License-Identifier: MIT

if SHIELD_LIZBALL

config ZMK_KEYBOARD_NAME
    default "Lizball"

config PMW3610
    default y

endif
```

## config/board/shields/lizball/kconfig.shield
```kconfig
# Copyright (c) 2025 ZMK Contributors
# SPDX-License-Identifier: MIT

config SHIELD_LIZBALL
    def_bool $(shields_list_contains,lizball)
    select SPI
    select PMW3610
```

## config/boards/shields/lizball/kconfig.defconfig
```kconfig
if SHIELD_LIZBALL

config ZMK_KEYBOARD_NAME
    default "LizBall Trackball"

# Default orientation setting
config LIZBALL_DEFAULT_ORIENTATION
    int "Default orientation mode on power-up"
    default 0
    range 0 1
    help
      Select the default orientation mode at power-on.
      0: Upward facing (Button 3 is Left Click)
      1: Downward facing (Button 1 is Left Click)

endif
```

## config/west.yml
```yaml
manifest:
  remotes:
    - name: zmkfirmware
      url-base: https://github.com/zmkfirmware
    - name: menbou0202
      url-base: https://github.com/menbou0202
  projects:
    - name: zmk
      remote: zmkfirmware
      revision: main
      import: app/west.yml
    - name: zmk-pmw3610-driver
      remote: menbou0202
      revision: main
  self:
    path: config
```
